/dts-v1/;
/plugin/;
/ {
  fragment@0 {
    target-path = "/";
    __overlay__ {
      sw-spi {
        compatible = "spi-gpio";
        #address-cells = <0x1>;
        #size-cells = <0x0>;
        sck-gpios = <&gpio 11 0>;
        mosi-gpios = <&gpio 5 0>;
        miso-gpios = <&gpio 4 0>;
        cs-gpios = <&gpio 23 0>;
        num-chipselects = <1>;

        spi-max-frequency = <100000>;
        spi-cs-high;

        /* clients */
        spidev@0 {
          compatible = "linux,spidev";
          reg = <0>;
          spi-max-frequency = <10000000>;
        };

      };

    };
  };
};
